// SPDX-License-Identifier: (GPL-2.0+ OR MIT)
/*
 * Copyright (c) 2022 Rockchip Electronics Co., Ltd.
 * Copyright (c) 2026 Microduck Team.
 *
 * Microduck board device tree.
 */

/dts-v1/;

#include "rk3566-microduck.dtsi"

/ {
	model = "Microduck Main Board V0.1";
	compatible = "seeed,microduck", "rockchip,rk3566";
};
